//-------------------------------------------------------------------
// Filename: hal_lcd.c  ST7565P
// Description: Functions for controlling the LCD
//-------------------------------------------------------------------
//-------------------------------------------------------------------
// INCLUDES
//-------------------------------------------------------------------
#include "hal_defs.h"
#include "hal_cc8051.h"
#include "hal_mcu.h"
#include "hal_board.h"
#include "hal_lcd.h"
#include "util.h"
#include <string.h>

//-------------------------------------------------------------------
// CONSTANTS AND DEFINES
//-------------------------------------------------------------------
#define LCD_LINE_COUNT                  4
#define LCD_LINE_LENGTH                 16

__code const uint8 Logo[] = 
{
    0xFF, 0x01, 0x01, 0x01, 0x01, 0x01, 0x01, 0x01, 0x01, 0x01, 0x01, 0x01,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 0x7F
};

//-------------------------------------------------------------------
// English Font  16 x 8   ASCII 32 ~ 127
//-------------------------------------------------------------------
__code const uint8 Font16x8[] = 
{
    //   - 32
    0x00, 0x00, 0x00, 0x00, 0x00, 0x00, 0x00, 0x00, 0x00, 0x00, 0x00, 0x00, 0x00, 0x00, 0x00, 0x00, 
    // ! - 33
    0x00, 0x00, 0x70, 0xF8, 0xF8, 0x70, 0x00, 0x00, 0x00, 0x00, 0x00, 0x0D, 0x0D, 0x00, 0x00, 0x00, 
    // " - 34
    0x00, 0x1C, 0x3C, 0x00, 0x00, 0x00, 0x3C, 0x1C, 0x00, 0x00, 0x00, 0x00, 0x00, 0x00, 0x00, 0x00, 
    // # - 35
    0x00, 0x20, 0xF8, 0xF8, 0x20, 0xF8, 0xF8, 0x20, 0x00, 0x02, 0x0F, 0x0F, 0x02, 0x0F, 0x0F, 0x02, 
    // $ - 36
    0x00, 0x70, 0xF8, 0x88, 0x8E, 0x8E, 0x98, 0x30, 0x00, 0x06, 0x0C, 0x08, 0x38, 0x38, 0x0F, 0x07, 
    // % - 37
    0x00, 0x60, 0x60, 0x00, 0x00, 0x80, 0xC0, 0x60, 0x00, 0x08, 0x0C, 0x06, 0x03, 0x01, 0x0C, 0x0C, 
    // & - 38
    0x00, 0x00, 0xB0, 0xF8, 0xC8, 0x78, 0xB0, 0x80, 0x00, 0x07, 0x0F, 0x08, 0x09, 0x07, 0x0F, 0x08, 
    // ' - 39
    0x00, 0x20, 0x3C, 0x1C, 0x00, 0x00, 0x00, 0x00, 0x00, 0x00, 0x00, 0x00, 0x00, 0x00, 0x00, 0x00, 
    // ( - 40
    0x00, 0x00, 0xE0, 0xF0, 0x18, 0x08, 0x00, 0x00, 0x00, 0x00, 0x03, 0x07, 0x0C, 0x08, 0x00, 0x00, 
    // ) - 41
    0x00, 0x00, 0x00, 0x08, 0x18, 0xF0, 0xE0, 0x00, 0x00, 0x00, 0x00, 0x08, 0x0C, 0x07, 0x03, 0x00, 
    // * - 42
    0x80, 0xA0, 0xE0, 0xC0, 0xC0, 0xE0, 0xA0, 0x80, 0x00, 0x02, 0x03, 0x01, 0x01, 0x03, 0x02, 0x00, 
    // + - 43
    0x80, 0x80, 0x80, 0xF0, 0xF0, 0x80, 0x80, 0x80, 0x00, 0x00, 0x00, 0x07, 0x07, 0x00, 0x00, 0x00, 
    // , - 44
    0x00, 0x00, 0x00, 0x00, 0x00, 0x00, 0x00, 0x00, 0x00, 0x00, 0x10, 0x1E, 0x0E, 0x00, 0x00, 0x00, 
    // - - 45
    0x80, 0x80, 0x80, 0x80, 0x80, 0x80, 0x80, 0x00, 0x00, 0x00, 0x00, 0x00, 0x00, 0x00, 0x00, 0x00, 
    // . - 46
    0x00, 0x00, 0x00, 0x00, 0x00, 0x00, 0x00, 0x00, 0x00, 0x00, 0x00, 0x0C, 0x0C, 0x00, 0x00, 0x00, 
    // / - 47
    0x00, 0x00, 0x00, 0x80, 0xC0, 0x60, 0x30, 0x18, 0x00, 0x06, 0x03, 0x01, 0x00, 0x00, 0x00, 0x00, 
    // 0 - 48
    0x00, 0xF0, 0xF8, 0x88, 0xC8, 0x68, 0xF8, 0xF0, 0x00, 0x07, 0x0F, 0x09, 0x08, 0x08, 0x0F, 0x07, 
    // 1 - 49
    0x00, 0x00, 0x20, 0x30, 0xF8, 0xF8, 0x00, 0x00, 0x00, 0x00, 0x08, 0x08, 0x0F, 0x0F, 0x08, 0x08, 
    // 2 - 50
    0x00, 0x10, 0x18, 0x08, 0x88, 0xC8, 0x78, 0x30, 0x00, 0x0C, 0x0E, 0x0B, 0x09, 0x08, 0x0C, 0x0C, 
    // 3 - 51
    0x00, 0x10, 0x18, 0x88, 0x88, 0x88, 0xF8, 0x70, 0x00, 0x04, 0x0C, 0x08, 0x08, 0x08, 0x0F, 0x07, 
    // 4 - 52
    0x00, 0x80, 0xC0, 0x60, 0x30, 0xF8, 0xF8, 0x00, 0x00, 0x01, 0x01, 0x01, 0x09, 0x0F, 0x0F, 0x09, 
    // 5 - 53
    0x00, 0xF8, 0xF8, 0x88, 0x88, 0x88, 0x88, 0x08, 0x00, 0x04, 0x0C, 0x08, 0x08, 0x08, 0x0F, 0x07, 
    // 6 - 54
    0x00, 0xE0, 0xF0, 0x98, 0x88, 0x88, 0x80, 0x00, 0x00, 0x07, 0x0F, 0x08, 0x08, 0x08, 0x0F, 0x07, 
    // 7 - 55
    0x00, 0x18, 0x18, 0x08, 0x88, 0xC8, 0x78, 0x38, 0x00, 0x00, 0x00, 0x0F, 0x0F, 0x00, 0x00, 0x00, 
    // 8 - 56
    0x00, 0x70, 0xF8, 0x88, 0x88, 0x88, 0xF8, 0x70, 0x00, 0x07, 0x0F, 0x08, 0x08, 0x08, 0x0F, 0x07, 
    // 9 - 57
    0x00, 0x70, 0xF8, 0x88, 0x88, 0x88, 0xF8, 0xF0, 0x00, 0x00, 0x08, 0x08, 0x08, 0x0C, 0x07, 0x03, 
    // : - 58
    0x00, 0x00, 0x00, 0x30, 0x30, 0x00, 0x00, 0x00, 0x00, 0x00, 0x00, 0x06, 0x06, 0x00, 0x00, 0x00, 
    // ; - 59
    0x00, 0x00, 0x00, 0x30, 0x30, 0x00, 0x00, 0x00, 0x00, 0x00, 0x08, 0x0E, 0x06, 0x00, 0x00, 0x00, 
    // < - 60
    0x00, 0x80, 0xC0, 0x60, 0x30, 0x18, 0x08, 0x00, 0x00, 0x00, 0x01, 0x03, 0x06, 0x0C, 0x08, 0x00, 
    // = - 61
    0x00, 0x40, 0x40, 0x40, 0x40, 0x40, 0x40, 0x00, 0x00, 0x02, 0x02, 0x02, 0x02, 0x02, 0x02, 0x00, 
    // > - 62
    0x00, 0x08, 0x18, 0x30, 0x60, 0xC0, 0x80, 0x00, 0x00, 0x08, 0x0C, 0x06, 0x03, 0x01, 0x00, 0x00, 
    // ? - 63
    0x00, 0x30, 0x38, 0x08, 0x88, 0xC8, 0x78, 0x30, 0x00, 0x00, 0x00, 0x00, 0x0D, 0x0D, 0x00, 0x00, 
    // @ - 64
    0x00, 0xF0, 0xF8, 0x08, 0xC8, 0xC8, 0xF8, 0xF0, 0x00, 0x07, 0x0F, 0x08, 0x0B, 0x0B, 0x0B, 0x01, 
    // A - 65
    0x00, 0xC0, 0xE0, 0x30, 0x18, 0x30, 0xE0, 0xC0, 0x00, 0x0F, 0x0F, 0x01, 0x01, 0x01, 0x0F, 0x0F, 
    // B - 66
    0x00, 0x08, 0xF8, 0xF8, 0x88, 0x88, 0xF8, 0x70, 0x00, 0x08, 0x0F, 0x0F, 0x08, 0x08, 0x0F, 0x07, 
    // C - 67
    0x00, 0xE0, 0xF0, 0x18, 0x08, 0x08, 0x18, 0x30, 0x00, 0x03, 0x07, 0x0C, 0x08, 0x08, 0x0C, 0x06, 
    // D - 68
    0x00, 0x08, 0xF8, 0xF8, 0x08, 0x18, 0xF0, 0xE0, 0x00, 0x08, 0x0F, 0x0F, 0x08, 0x0C, 0x07, 0x03, 
    // E - 69
    0x00, 0x08, 0xF8, 0xF8, 0x88, 0xC8, 0x18, 0x38, 0x00, 0x08, 0x0F, 0x0F, 0x08, 0x09, 0x0C, 0x0E, 
    // F - 70
    0x00, 0x08, 0xF8, 0xF8, 0x88, 0xC8, 0x18, 0x38, 0x00, 0x08, 0x0F, 0x0F, 0x08, 0x01, 0x00, 0x00, 
    // G - 71
    0x00, 0xE0, 0xF0, 0x18, 0x08, 0x08, 0x18, 0x30, 0x00, 0x03, 0x07, 0x0C, 0x09, 0x09, 0x07, 0x0F, 
    // H - 72
    0x00, 0xF8, 0xF8, 0x80, 0x80, 0x80, 0xF8, 0xF8, 0x00, 0x0F, 0x0F, 0x00, 0x00, 0x00, 0x0F, 0x0F, 
    // I - 73
    0x00, 0x00, 0x08, 0xF8, 0xF8, 0x08, 0x00, 0x00, 0x00, 0x00, 0x08, 0x0F, 0x0F, 0x08, 0x00, 0x00, 
    // J - 74
    0x00, 0x00, 0x00, 0x00, 0x08, 0xF8, 0xF8, 0x08, 0x00, 0x06, 0x0E, 0x08, 0x08, 0x0F, 0x07, 0x00, 
    // K - 75
    0x00, 0x08, 0xF8, 0xF8, 0x80, 0xE0, 0x78, 0x18, 0x00, 0x08, 0x0F, 0x0F, 0x00, 0x03, 0x0F, 0x0C, 
    // L - 76
    0x00, 0x08, 0xF8, 0xF8, 0x08, 0x00, 0x00, 0x00, 0x00, 0x08, 0x0F, 0x0F, 0x08, 0x08, 0x0C, 0x0E, 
    // M - 77
    0x00, 0xF8, 0xF8, 0x30, 0x60, 0x30, 0xF8, 0xF8, 0x00, 0x0F, 0x0F, 0x00, 0x00, 0x00, 0x0F, 0x0F, 
    // N - 78
    0x00, 0xF8, 0xF8, 0x70, 0xE0, 0xC0, 0xF8, 0xF8, 0x00, 0x0F, 0x0F, 0x00, 0x00, 0x01, 0x0F, 0x0F, 
    // O - 79
    0x00, 0xE0, 0xF0, 0x18, 0x08, 0x18, 0xF0, 0xE0, 0x00, 0x03, 0x07, 0x0C, 0x08, 0x0C, 0x07, 0x03, 
    // P - 80
    0x00, 0x08, 0xF8, 0xF8, 0x88, 0x88, 0xF8, 0x70, 0x00, 0x08, 0x0F, 0x0F, 0x08, 0x00, 0x00, 0x00, 
    // Q - 81
    0x00, 0xF0, 0xF8, 0x08, 0x08, 0x08, 0xF8, 0xF0, 0x00, 0x03, 0x07, 0x04, 0x07, 0x1E, 0x1F, 0x13, 
    // R - 82
    0x00, 0x08, 0xF8, 0xF8, 0x88, 0x88, 0xF8, 0x70, 0x00, 0x08, 0x0F, 0x0F, 0x00, 0x01, 0x0F, 0x0E, 
    // S - 83
    0x00, 0x30, 0x78, 0xC8, 0x88, 0x88, 0x38, 0x30, 0x00, 0x06, 0x0E, 0x08, 0x08, 0x09, 0x0F, 0x06, 
    // T - 84
    0x18, 0x08, 0x08, 0xF8, 0xF8, 0x08, 0x08, 0x18, 0x00, 0x00, 0x08, 0x0F, 0x0F, 0x08, 0x00, 0x00, 
    // U - 85
    0x00, 0xF8, 0xF8, 0x00, 0x00, 0x00, 0xF8, 0xF8, 0x00, 0x07, 0x0F, 0x08, 0x08, 0x08, 0x0F, 0x07, 
    // V - 86
    0x00, 0xF8, 0xF8, 0x00, 0x00, 0x00, 0xF8, 0xF8, 0x00, 0x01, 0x03, 0x06, 0x0C, 0x06, 0x03, 0x01, 
    // W - 87
    0x00, 0xF8, 0xF8, 0x00, 0x00, 0x00, 0xF8, 0xF8, 0x00, 0x0F, 0x0F, 0x06, 0x03, 0x06, 0x0F, 0x0F, 
    // X - 88
    0x00, 0x38, 0x78, 0xC0, 0x80, 0xC0, 0x78, 0x38, 0x00, 0x0E, 0x0F, 0x01, 0x00, 0x01, 0x0F, 0x0E, 
    // Y - 89
    0x00, 0x38, 0x78, 0xC0, 0x80, 0xC0, 0x78, 0x38, 0x00, 0x00, 0x08, 0x0F, 0x0F, 0x0F, 0x08, 0x00, 
    // Z - 90
    0x00, 0x38, 0x18, 0x88, 0xC8, 0x68, 0x38, 0x18, 0x00, 0x0E, 0x0F, 0x09, 0x08, 0x08, 0x0C, 0x0E, 
    // [ - 91
    0x00, 0x00, 0xF8, 0xF8, 0x08, 0x08, 0x00, 0x00, 0x00, 0x00, 0x0F, 0x0F, 0x08, 0x08, 0x00, 0x00, 
    // \ - 92
    0x00, 0x38, 0x70, 0xE0, 0xC0, 0x80, 0x00, 0x00, 0x00, 0x00, 0x00, 0x00, 0x01, 0x03, 0x07, 0x0E, 
    // ] - 93
    0x00, 0x00, 0x08, 0x08, 0xF8, 0xF8, 0x00, 0x00, 0x00, 0x00, 0x08, 0x08, 0x0F, 0x0F, 0x00, 0x00, 
    // ^ - 94
    0x00, 0x10, 0x18, 0x0C, 0x06, 0x0C, 0x18, 0x10, 0x00, 0x00, 0x00, 0x00, 0x00, 0x00, 0x00, 0x00, 
    // _ - 95
    0x00, 0x00, 0x00, 0x00, 0x00, 0x00, 0x00, 0x00, 0x00, 0x20, 0x20, 0x20, 0x20, 0x20, 0x20, 0x00, 
    // ` - 96
    0x00, 0x00, 0x00, 0x06, 0x0E, 0x08, 0x00, 0x00, 0x00, 0x00, 0x00, 0x00, 0x00, 0x00, 0x00, 0x00, 
    // a - 97
    0x00, 0x00, 0x40, 0x40, 0x40, 0xC0, 0x80, 0x00, 0x00, 0x06, 0x0F, 0x09, 0x09, 0x07, 0x0F, 0x08, 
    // b - 98
    0x00, 0x08, 0xF8, 0xF8, 0x40, 0xC0, 0x80, 0x00, 0x00, 0x08, 0x0F, 0x07, 0x08, 0x08, 0x0F, 0x07, 
    // c - 99
    0x00, 0x80, 0xC0, 0x40, 0x40, 0x40, 0xC0, 0x80, 0x00, 0x07, 0x0F, 0x08, 0x08, 0x08, 0x0C, 0x04, 
    // d - 100
    0x00, 0x00, 0x80, 0xC0, 0x48, 0xF8, 0xF8, 0x00, 0x00, 0x07, 0x0F, 0x08, 0x08, 0x07, 0x0F, 0x08, 
    // e - 101
    0x00, 0x80, 0xC0, 0x40, 0x40, 0x40, 0xC0, 0x80, 0x00, 0x07, 0x0F, 0x09, 0x09, 0x09, 0x0D, 0x05, 
    // f - 102
    0x00, 0x80, 0xF0, 0xF8, 0x88, 0x98, 0x30, 0x00, 0x00, 0x08, 0x0F, 0x0F, 0x08, 0x00, 0x00, 0x00, 
    // g - 103
    0x00, 0x80, 0xC0, 0x40, 0x40, 0x80, 0xC0, 0x40, 0x00, 0x13, 0x37, 0x24, 0x24, 0x3F, 0x1F, 0x00, 
    // h - 104
    0x00, 0x08, 0xF8, 0xF8, 0x80, 0x40, 0xC0, 0x80, 0x00, 0x08, 0x0F, 0x0F, 0x00, 0x00, 0x0F, 0x0F, 
    // i - 105
    0x00, 0x00, 0x00, 0x40, 0xD8, 0xD8, 0x00, 0x00, 0x00, 0x00, 0x00, 0x08, 0x0F, 0x0F, 0x08, 0x00, 
    // j - 106
    0x00, 0x00, 0x00, 0x00, 0x40, 0xD8, 0xD8, 0x00, 0x00, 0x18, 0x38, 0x20, 0x20, 0x3F, 0x1F, 0x00, 
    // k - 107
    0x00, 0x08, 0xF8, 0xF8, 0x00, 0x80, 0xC0, 0x40, 0x00, 0x08, 0x0F, 0x0F, 0x01, 0x03, 0x0E, 0x0C, 
    // l - 108
    0x00, 0x00, 0x00, 0x08, 0xF8, 0xF8, 0x00, 0x00, 0x00, 0x00, 0x00, 0x08, 0x0F, 0x0F, 0x08, 0x00, 
    // m - 109
    0x00, 0x80, 0xC0, 0x80, 0x80, 0x80, 0xC0, 0x80, 0x00, 0x0F, 0x0F, 0x00, 0x0F, 0x00, 0x0F, 0x0F, 
    // n - 110
    0x00, 0x40, 0xC0, 0x80, 0x40, 0x40, 0xC0, 0x80, 0x00, 0x00, 0x0F, 0x0F, 0x00, 0x00, 0x0F, 0x0F, 
    // o - 111
    0x00, 0x80, 0xC0, 0x40, 0x40, 0x40, 0xC0, 0x80, 0x00, 0x07, 0x0F, 0x08, 0x08, 0x08, 0x0F, 0x07, 
    // p - 112
    0x00, 0x40, 0xC0, 0x80, 0x40, 0x40, 0xC0, 0x80, 0x00, 0x20, 0x3F, 0x3F, 0x24, 0x04, 0x07, 0x03, 
    // q - 113
    0x00, 0x80, 0xC0, 0x40, 0x40, 0x80, 0xC0, 0x40, 0x00, 0x03, 0x07, 0x04, 0x24, 0x3F, 0x3F, 0x20, 
    // r - 114
    0x00, 0x40, 0xC0, 0x80, 0xC0, 0x40, 0xC0, 0x80, 0x00, 0x08, 0x0F, 0x0F, 0x08, 0x00, 0x01, 0x01, 
    // s - 115
    0x00, 0x80, 0xC0, 0x40, 0x40, 0x40, 0xC0, 0x80, 0x00, 0x04, 0x0D, 0x09, 0x0B, 0x0A, 0x0E, 0x04, 
    // t - 116
    0x00, 0x40, 0x40, 0xF0, 0xF8, 0x40, 0x40, 0x00, 0x00, 0x00, 0x00, 0x07, 0x0F, 0x08, 0x0C, 0x04, 
    // u - 117
    0x00, 0xC0, 0xC0, 0x00, 0x00, 0xC0, 0xC0, 0x00, 0x00, 0x07, 0x0F, 0x08, 0x08, 0x07, 0x0F, 0x08, 
    // v - 118
    0x00, 0xC0, 0xC0, 0x00, 0x00, 0x00, 0xC0, 0xC0, 0x00, 0x01, 0x03, 0x06, 0x0C, 0x06, 0x03, 0x01, 
    // w - 119
    0x00, 0xC0, 0xC0, 0x00, 0x00, 0x00, 0xC0, 0xC0, 0x00, 0x07, 0x0F, 0x0C, 0x06, 0x0C, 0x0F, 0x07, 
    // x - 120
    0x00, 0x40, 0xC0, 0x80, 0x00, 0x80, 0xC0, 0x40, 0x00, 0x08, 0x0C, 0x07, 0x03, 0x07, 0x0C, 0x08, 
    // y - 121
    0x00, 0xC0, 0xC0, 0x00, 0x00, 0x00, 0xC0, 0xC0, 0x00, 0x03, 0x27, 0x24, 0x24, 0x34, 0x1F, 0x0F, 
    // z - 122
    0x00, 0xC0, 0xC0, 0x40, 0x40, 0xC0, 0xC0, 0x40, 0x00, 0x08, 0x0C, 0x0E, 0x0B, 0x09, 0x0C, 0x0C, 
    // { - 123
    0x00, 0x80, 0x80, 0xF0, 0x78, 0x08, 0x08, 0x00, 0x00, 0x00, 0x00, 0x07, 0x0F, 0x08, 0x08, 0x00, 
    // | - 124
    0x00, 0x00, 0x00, 0x78, 0x78, 0x00, 0x00, 0x00, 0x00, 0x00, 0x00, 0x0F, 0x0F, 0x00, 0x00, 0x00, 
    // } - 125
    0x00, 0x08, 0x08, 0x78, 0xF0, 0x80, 0x80, 0x00, 0x00, 0x08, 0x08, 0x0F, 0x07, 0x00, 0x00, 0x00, 
    // ~ - 126
    0x00, 0x10, 0x18, 0x08, 0x18, 0x10, 0x18, 0x08, 0x00, 0x00, 0x00, 0x00, 0x00, 0x00, 0x00, 0x00, 
    //  - 127
    0x00, 0x00, 0x00, 0x0E, 0x0A, 0x0E, 0x00, 0x00, 0x00, 0x00, 0x00, 0x00, 0x00, 0x00, 0x00, 0x00

};



//-------------------------------------------------------------------
// LOCAL VARIABLES
//-------------------------------------------------------------------
static char pLcdLineBuffer[LCD_LINE_LENGTH];

//-------------------------------------------------------------------
// LOCAL FUNCTIONS
//-------------------------------------------------------------------
static void lcdCommand(uint8 command);
static void lcdData(uint8 ch);

//-------------------------------------------------------------------
// @fn          lcdCommand
// @brief       Send command to display
// @param       uint8 command
// @return      none
//-------------------------------------------------------------------
static void lcdCommand(uint8 command)
{
    uint8 i;
    HAL_LCD_A0_CLR();
    HAL_LCD_CS_CLR();
    for (i = 0; i < 8; i++)
    {
        if (command &(0x80 >> i))
        {
            HAL_LCD_SI_SET();
        }
        else
        {
            HAL_LCD_SI_CLR();
        }
        HAL_LCD_SCL_CLR();
        HAL_LCD_SCL_SET();
    }
    HAL_LCD_CS_SET();
    HAL_LCD_SI_SET();
    HAL_LED_PORT(pLedData);
}

//-------------------------------------------------------------------
// @fn          lcdData
// @brief       Write character to display
// @param       uint8 ch - character to display
// @return      none
//-------------------------------------------------------------------
static void lcdData(uint8 ch)
{
    uint8 i;
    HAL_LCD_A0_SET();
    HAL_LCD_CS_CLR();
    for (i = 0; i < 8; i++)
    {
        if (ch &(0x80 >> i))
        {
            HAL_LCD_SI_SET();
        }
        else
        {
            HAL_LCD_SI_CLR();
        }
        HAL_LCD_SCL_CLR();
        HAL_LCD_SCL_SET();
    }
    HAL_LCD_CS_SET();
    HAL_LCD_SI_SET();
    HAL_LED_PORT(pLedData);
}

//-------------------------------------------------------------------
// GLOBAL FUNCTIONS
//-------------------------------------------------------------------
// @fn          halLcdInit
// @brief       Initalise LCD
// @param       none
// @return      none
//-------------------------------------------------------------------
void halLcdInit(void)
{
    lcdCommand(0xE2); //Reset Function
    halMcuWaitMs(5);
    lcdCommand(0xE2); //Reset Function
    halMcuWaitMs(5);
    lcdCommand(0x2F); //Set Power Control
    halMcuWaitMs(2);
    lcdCommand(0x2F); //Set Power Control
    halMcuWaitMs(2);

    lcdCommand(0xF8); //Set BOOSTER RATIO SET 1
    lcdCommand(0x01); //Set BOOSTER RATIO SET 2 (5X)

    lcdCommand(0xA3); //Set 1/7 Bias
    lcdCommand(0x26); //Set V5 Ratio
    lcdCommand(0x81); //Set Electronic Mode
    lcdCommand(0x20); //Set Electronic EQUister 

    lcdCommand(0xC0); //COM output -> 0xC0:normal;0xC8:reverse
    lcdCommand(0xA1); //SEG output -> 0xA0:normal;0xA1:reverse
    lcdCommand(0xA6); //LCD display -> 0xA6:normal;0xA7:reverse
    lcdCommand(0xAF); //LCD display -> 0xAF:on;0xAE:off

    halMcuWaitMs(20);
    lcdCommand(0x40); //Start Line

    halLcdClear();

    //    halLcdDrawLine(0,0,127,63); 

}

//-------------------------------------------------------------------
// @fn          halLcdClearLine
// @brief       Clear one lines on display
// @param       uint8 line - display line
// @return      none
//-------------------------------------------------------------------
void halLcdClearLine(uint8 line)
{
    uint8 i, j, page;
    page = 0xB0 + ((line - 1) *2);
    for (i = 0; i < 2; i++)
    {
        lcdCommand(page++); //寫頁地址
        lcdCommand(0x10); //寫初始列地址
        lcdCommand(0x04);
        for (j = 0; j < 128; j++)
        {
            lcdData(0x00); //寫顯示資料
        }
    }
}

//-------------------------------------------------------------------
// @fn          halLcdClear
// @brief       Clear all lines on display
// @param       none
// @return      none
//-------------------------------------------------------------------
void halLcdClear(void)
{
    uint8 i, j;
    for (i = 0xB0; i < 0xB8; i++)
    {
        lcdCommand(i); //寫頁地址
        lcdCommand(0x10); //寫初始列地址
        lcdCommand(0x04);
        for (j = 0; j < 128; j++)
        {
            lcdData(0x00); //寫顯示資料
        }
    }
}

//-------------------------------------------------------------------
// @fn          halLcdGetLineLength
// @brief       Get max number of characters on each line
// @param       nono
// @return      uint8 - number of characters on a line
//-------------------------------------------------------------------
uint8 halLcdGetLineLength(void)
{
    return LCD_LINE_LENGTH;
}

//-------------------------------------------------------------------
// @fn          halLcdGetNumLines
// @brief       Get number of lines on display
// @param       nono
// @return      uint8 - number of characters on a line
//-------------------------------------------------------------------
uint8 halLcdGetNumLines(void)
{
    return LCD_LINE_COUNT;
}

//-------------------------------------------------------------------
// @fn          halLcdDrawLogo
// @brief       Write 128x64 image
// @return      none
//-------------------------------------------------------------------
void halLcdDrawLogo(void)
{
    uint16 no;
    uint8 i, j;
    no=0;
    for (i = 0; i < 8; i++)
    {
        lcdCommand(0xB0 + i);
        lcdCommand(0x10);
        lcdCommand(0x04);
        for (j = 0; j < 128; j++)
        {
            lcdData(Logo[no++]);
        }
    }
}

//-------------------------------------------------------------------
// @fn          halLcdWriteChar
// @brief       Write single character
// @param       uint8 line - display line
//              uint8 col - column
//              char text - character to display
// @return      none
//-------------------------------------------------------------------
void halLcdWriteChar(uint8 line, uint8 col, char ch)
{
    uint8 i, pag, colh, coll;

    pag = ((line - 1) *2) + 0xB0;
    col *= 8;
    col += 4;
    colh = col >> 4;
    colh = colh | 0xf0;
    colh = colh &0x1f;
    coll = col &0x0f;

    if (ch < 32 || ch > 127)
    {
        ch = 32;
    }
    uint16 j = ((uint16)(ch - 32)) *16;

    lcdCommand(colh);
    lcdCommand(coll);
    lcdCommand(pag);
    for (i = 0; i < 16; i++)
    {
        if (i == 8)
        {
            lcdCommand(pag + 1);
            lcdCommand(colh);
            lcdCommand(coll);
        }
        lcdData(Font16x8[j++]);
    }
}

//-------------------------------------------------------------------
// @fn          halLcdWriteString
// @brief       Write string on display
// @param       uint8 line - display line
//              uint8 col - column
//              char *pText - text buffer to write
// @return      none
//-------------------------------------------------------------------
void halLcdWriteString(uint8 line, uint8 col, char *pText)
{
    uint8 i, len;
    len = strlen(pText);
    for (i = 0; i < len; i++)
    {
        halLcdWriteChar(line, col + i, pText[i]);
    }
}

//-------------------------------------------------------------------
// @fn          halLcdWriteLine
// @brief       Write line on display
// @param       uint8 line - display line
//              char *pLine2 - pointer to text buffer to write
// @return      none
//-------------------------------------------------------------------
void halLcdWriteLine(uint8 line, char *pLine)
{
    uint8 n;
    if (pLine)
    {
        for (n = 0; n < LCD_LINE_LENGTH; n++)
        {
            if (*pLine)
            {
                pLcdLineBuffer[n] = *(pLine++);
            }
            else
            {
                pLcdLineBuffer[n] = ' ';
            }
        }
        halLcdWriteString(line, 0, pLcdLineBuffer);
    }
}

//-------------------------------------------------------------------
// @fn          halLcdWriteLines
// @brief       Write lines on display
// @param       char *pLine1 - pointer to text buffer for line 1
//              char *pLine2 - pointer to text buffer for line 2
// @return      none
//-------------------------------------------------------------------
void halLcdWriteLines(char *pLine1, char *pLine2, char *pLine3, char *pLine4)
{
    if (pLine1)
    {
        halLcdWriteLine(HAL_LCD_LINE_1, pLine1);
    }
    if (pLine2)
    {
        halLcdWriteLine(HAL_LCD_LINE_2, pLine2);
    }
    if (pLine3)
    {
        halLcdWriteLine(HAL_LCD_LINE_3, pLine3);
    }
    if (pLine4)
    {
        halLcdWriteLine(HAL_LCD_LINE_4, pLine4);
    }
}

//-------------------------------------------------------------------
// @fn          halLcdDisplayValue
// @brief       Display value on display with optional text on right and left side
// @param       uint8 line
//              char *pLeft
//              int32 value
//              char *pRight
// @return      none
//-------------------------------------------------------------------
void halLcdDisplayValue(uint8 line, char *pLeft, int32 value, char *pRight)
{
    uint8 n;
    char *pValue = convInt32ToText(value);
    for (n = 0; n < LCD_LINE_LENGTH; n++)
    {
        if (pLeft &&  *pLeft)
        {
            pLcdLineBuffer[n] = *(pLeft++);
        }
        else if (*pValue)
        {
            pLcdLineBuffer[n] = *(pValue++);
        }
        else if (pRight &&  *pRight)
        {
            pLcdLineBuffer[n] = *(pRight++);
        }
        else
        {
            pLcdLineBuffer[n] = ' ';
        }
    }
    halLcdWriteLine(line, pLcdLineBuffer);
}

//-------------------------------------------------------------------
// @fn          halLcdDisplayCounters
// @brief       Display counter values with text on display
// @param       uint8 line - display line
//              int32 lValue - left value
//              char lChar - left text
//              int32 rValue - right value
//              char rChar - right text
// @return      none
//-------------------------------------------------------------------
void halLcdDisplayCounters(uint8 line, int32 lValue, char lChar, int32 rValue, char rChar)
{
    uint8 n;
    char *pCounter;

    // Left part
    pLcdLineBuffer[0] = lChar;
    pLcdLineBuffer[1] = '=';
    pCounter = convInt32ToText(lValue);
    for (n = 2; n < 8; n++)
    {
        if (*pCounter)
        {
            pLcdLineBuffer[n] = *(pCounter++);
        }
        else
        {
            pLcdLineBuffer[n] = ' ';
        }
    }
    pLcdLineBuffer[8] = rChar;
    pLcdLineBuffer[9] = '=';
    pCounter = convInt32ToText(rValue);
    for (n = 10; n < 16; n++)
    {
        if (*pCounter)
        {
            pLcdLineBuffer[n] = *(pCounter++);
        }
        else
        {
            pLcdLineBuffer[n] = ' ';
        }
    }
    halLcdWriteLine(line, pLcdLineBuffer);
}

static const char hex[] = 
{
    '0', '1', '2', '3', '4', '5', '6', '7', '8', '9', 'A', 'B', 'C', 'D', 'E', 'F'
};
//-------------------------------------------------------------------
// @fn          halLcdDisplayUint16
// @brief       Write a 16 bit value on the specified line on the LCD
// @param       uint16 value - value to display
//              uint8 radix - must be HAL_LCD_RADIX_DEC
//              uint8 line - line on display
// @return      none
//-------------------------------------------------------------------
void halLcdDisplayUint16(uint8 line, uint8 col, uint8 radix, uint16 value)
{
    if (radix == HAL_LCD_RADIX_DEC)
    {
        uint8 n = 0;
        char *pValue = convInt32ToText((uint32)value);
        while (*pValue)
        {
            halLcdWriteChar(line, col + n++, *(pValue++));
        }
        while (n < 5)
        {
            halLcdWriteChar(line, col + n++, ' ');
        }
    }
    else if (radix == HAL_LCD_RADIX_HEX)
    {
        halLcdWriteChar(line, col, hex[(value &0xF000) >> 12]);
        halLcdWriteChar(line, col + 1, hex[(value &0x0F00) >> 8]);
        halLcdWriteChar(line, col + 2, hex[(value &0x00F0) >> 4]);
        halLcdWriteChar(line, col + 3, hex[(value &0x000F)]);
    }
}

//-------------------------------------------------------------------
// @fn          halLcdDisplayUint8
// @brief       Write a 8 bit value on the specified line on the LCD
// @param       uint8 value - value to display
//              uint8 radix - must be HAL_LCD_RADIX_DEC
//              uint8 line - line on display
// @return      none
//-------------------------------------------------------------------
void halLcdDisplayUint8(uint8 line, uint8 col, uint8 radix, uint8 value)
{
    if (radix == HAL_LCD_RADIX_DEC)
    {
        uint8 n = 0;
        char *pValue = convInt32ToText((uint32)value);
        while (*pValue)
        {
            halLcdWriteChar(line, col + n++, *(pValue++));
        }
        while (n < 3)
        {
            halLcdWriteChar(line, col + n++, ' ');
        }
    }
    else if (radix == HAL_LCD_RADIX_HEX)
    {
        halLcdWriteChar(line, col, hex[(value &0xF0) >> 4]);
        halLcdWriteChar(line, col + 1, hex[(value &0x0F)]);
    }
}



#define DrawVertLine(x, y, length) FillRect(x, y, 0, length)
#define DrawHoriLine(x, y, length) FillRect(x, y, length, 0)
#define DrawCircle(xCenter, yCenter, radius) DrawRoundRect(xCenter-radius, yCenter-radius, 2*radius, 2*radius, radius)


void posi(uint8 x_add, uint8 y_add)
{
    uint8 pag, colh, coll;

    pag = (x_add *2) + 0xB0;
    y_add += 4;
    colh = y_add >> 4;
    colh = colh | 0xf0;
    colh = colh &0x1f;
    coll = y_add &0x0f;

    lcdCommand(colh);
    lcdCommand(coll);
    lcdCommand(pag);
}


void FillRect(uint8 x, uint8 y, uint8 width, uint8 height)
{
    uint8 mask, pageOffset, h, i;

    height++;

    pageOffset = y % 8;
    y -= pageOffset;
    mask = 0xFF;
    if (height < 8-pageOffset)
    {
        mask >>= (8-height);
        h = height;
    }
    else
    {
        h = 8-pageOffset;
    }
    mask <<= pageOffset;

    posi(x, y);
    for (i = 0; i <= width; i++)
    {
        lcdData(mask);
    }

    while (h + 8 <= height)
    {
        h += 8;
        y += 8;
        posi(x, y);

        for (i = 0; i <= width; i++)
        {
            //lcdData(color);
        }
    }

    if (h < height)
    {
        mask = ~(0xFF << (height - h));
        posi(x, y + 8);

        for (i = 0; i <= width; i++)
        {
            lcdData(mask);
        }
    }
}

void halLcdDrawLine(uint8 x1, uint8 y1, uint8 x2, uint8 y2)
{
    uint8 length, i, y, yAlt, xTmp, yTmp;
    int16 m;
    //
    // vertical line
    //
    if (x1 == x2)
    {
        // x1|y1 must be the upper point
        if (y1 > y2)
        {
            yTmp = y1;
            y1 = y2;
            y2 = yTmp;
        }
        DrawVertLine(x1, y1, y2 - y1);

        //
        // horizontal line
        //
    }
    else if (y1 == y2)
    {
        // x1|y1 must be the left point
        if (x1 > x2)
        {
            xTmp = x1;
            x1 = x2;
            x2 = xTmp;
        }
        DrawHoriLine(x1, y1, x2 - x1);

        //
        // angled line :)
        //
    }
    else
    {
        // angle >= 45?
        if ((y2 - y1) >= (x2 - x1) || (y1 - y2) >= (x2 - x1))
        {
            // x1 must be smaller than x2
            if (x1 > x2)
            {
                xTmp = x1;
                yTmp = y1;
                x1 = x2;
                y1 = y2;
                x2 = xTmp;
                y2 = yTmp;
            }

            length = x2 - x1; // not really the length :)
            m = ((y2 - y1) *200) / length;
            yAlt = y1;

            for (i = 0; i <= length; i++)
            {
                y = ((m *i) / 200) + y1;

                if ((m *i) % 200 >= 100)
                {
                    y++;
                }
                else if ((m *i) % 200 <=  - 100)
                {
                    y--;
                }

                halLcdDrawLine(x1 + i, yAlt, x1 + i, y);

                if (length <= (y2 - y1) && y1 < y2)
                {
                    yAlt = y + 1;
                }
                else if (length <= (y1 - y2) && y1 > y2)
                {
                    yAlt = y - 1;
                }
                else
                {
                    yAlt = y;
                }
            }

            // angle < 45?
        }
        else
        {
            // y1 must be smaller than y2
            if (y1 > y2)
            {
                xTmp = x1;
                yTmp = y1;
                x1 = x2;
                y1 = y2;
                x2 = xTmp;
                y2 = yTmp;
            }

            length = y2 - y1;
            m = ((x2 - x1) *200) / length;
            yAlt = x1;

            for (i = 0; i <= length; i++)
            {
                y = ((m *i) / 200) + x1;

                if ((m *i) % 200 >= 100)
                {
                    y++;
                }
                else if ((m *i) % 200 <=  - 100)
                {
                    y--;
                }

                halLcdDrawLine(yAlt, y1 + i, y, y1 + i);
                if (length <= (x2 - x1) && x1 < x2)
                {
                    yAlt = y + 1;
                }
                else if (length <= (x1 - x2) && x1 > x2)
                {
                    yAlt = y - 1;
                }
                else
                {
                    yAlt = y;
                }
            }
        }
    }
}
